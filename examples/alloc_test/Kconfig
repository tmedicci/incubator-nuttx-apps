## examples/alloc_test/Kconfig
```kconfig
#
# For a description of the syntax of this configuration file,
# see the file kconfig-language.txt in the NuttX tools repository.
#

config EXAMPLES_ALLOC_TEST
	tristate "Allocation test"
	default n
	---help---
		Test allocation and memory mapping using virtual memory.

if EXAMPLES_ALLOC_TEST

config EXAMPLES_ALLOC_TEST_PROGNAME
	string "Program name"
	default "alloc_test"
	---help---
		This is the name of the program that will be used when the NSH ELF
		program is installed.

config EXAMPLES_ALLOC_TEST_PRIORITY
	int "Alloc test task priority"
	default 100

config EXAMPLES_ALLOC_TEST_STACKSIZE
	int "Alloc test stack size"
	default DEFAULT_TASK_STACKSIZE

endif
```

## examples/stack_test/Kconfig
```kconfig
#
# For a description of the syntax of this configuration file,
# see the file kconfig-language.txt in the NuttX tools repository.
#

config EXAMPLES_STACK_TEST
	tristate "Test stack usage"
	default n
	---help---
		Test stack usage by recursively calling a function.

if EXAMPLES_STACK_TEST

config EXAMPLES_STACK_TEST_PROGNAME
	string "Program name"
	default "stack_test"
	---help---
		This is the name of the program that will be used when the NSH ELF
		program is installed.

config EXAMPLES_STACK_TEST_PRIORITY
	int "Stack test task priority"
	default 100

config EXAMPLES_STACK_TEST_STACKSIZE
	int "Stack test stack size"
	default DEFAULT_TASK_STACKSIZE

endif
```

## testing/isrmq/Kconfig
```kconfig
#
# For a description of the syntax of this configuration file,
# see the file kconfig-language.txt in the NuttX tools repository.
#

config TESTING_ISRMQ
	tristate "ISR + MQ example"
	default n

if TESTING_ISRMQ

config TESTING_ISRMQ_PROGNAME
	string "Program name"
	default "isrmq"
	---help---
		This is the name of the program that will be used when the NSH ELF
		program is installed.

config TESTING_ISRMQ_PRIORITY
	int "ISR + MQ task priority"
	default 100

config TESTING_ISRMQ_STACKSIZE
	int "ISR + MQ stack size"
	default DEFAULT_TASK_STACKSIZE

endif
```
